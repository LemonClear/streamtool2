## configs/simu_defconfig
```kconfig
#product
CONFIG_PRODUCT_REG_COUNT=256
#boardlink
CONFIG_BOARDLINK_COUNT=0
CONFIG_BOARDLINK_REG_COUNT=256
#board
CONFIG_BOARD_COUNT=1
CONFIG_BOARD_REG_COUNT=256
#chiplink
CONFIG_CHIPLINK_COUNT=0
CONFIG_CHIPLINK_REG_COUNT=256
#chip
CONFIG_CHIP_COUNT=1
CONFIG_CHIP_REG_COUNT=256
#ddr
CONFIG_DDR_COUNT=0
CONFIG_DDR_REG_COUNT=256
CONFIG_DDR_SIZE=1073741824
#fifo
CONFIG_FIFO_COUNT=0
CONFIG_FIFO_REG_COUNT=256
CONFIG_FIFO_SIZE=131072
#pcie
CONFIG_PCIE_COUNT=0
CONFIG_PCIE_REG_COUNT=256
#main cpu
CONFIG_MAINCPU_COUNT=0
CONFIG_MAINCPU_REG_COUNT=256
#noc
CONFIG_NOC_COUNT=4
CONFIG_NOC_REG_COUNT=256
#core
CONFIG_CORE_COUNT=768
CONFIG_CORE_REG_COUNT=256
#mcu
CONFIG_MCU_COUNT=1
CONFIG_MCU_REG_COUNT=256
#ncp
CONFIG_NCP_COUNT=1
CONFIG_NCP_REG_COUNT=256
#tcp
CONFIG_TCP_COUNT=1
CONFIG_TCP_REG_COUNT=256
#ram
CONFIG_RAM_COUNT=5
CONFIG_RAM_REG_COUNT=256
CONFIG_RAM_SIZE=262144
```
